## components/Kconfig
```kconfig
menu "RP Lidar Config"

    config RP_LIDAR_DEBUG
        bool "Low Level Debug"
        default n
        help
            Low Level Debug

    config RPLIDAR_MOTOR_GPIO
        int "MOTOR PIN"
        default 6

    config RPLIDAR_UART_BAUDRATE
        int "UART BAUDRATE"
        default 115200

    config RPLIDAR_UART_PORT_NUM
        int "UART PORT NUM"
        default 2

    config RPLIDAR_UART_TX_PIN
        int "TX IO PIN"
        default 4

    config RPLIDAR_UART_RX_PIN
        int "RX IO PIN"
        default 5

endmenu
```

## main/Kconfig.projbuild
```kconfig
menu "ESP Rover Config"

    config VL53L0X_DEBUG
    bool "Low level debug"
    default n
    help
        Low level debug


    config ESP_ROVER_DEBUG
    bool "Low level debug"
    default n
    help
        Low level debug

    config ESP_ROVER_MAX_POWER
        int "max power pct"
        default 100

    menu "Autodrive Thresholds"
        config AUTODRIVE_FRONT_CENTER_THRESHOLD
            int "front center"
            default 420
        config AUTODRIVE_FRONT_LATERAL1_THRESHOLD
            int "front lateral 1"
            default 420
        config AUTODRIVE_FRONT_LATERAL2_THRESHOLD
            int "front lateral 2"
            default 420
        config AUTODRIVE_SIDE_CENTER_THRESHOLD
            int "side center"
            default 250
    endmenu
    menu "TOF Sensor Config"
        config TOF0_XSHUT
             int "tof0 xshut"
             default 14
        config TOF1_XSHUT
            int "tof1 xshut"
            default 26
        config TOF2_XSHUT
            int "tof2 xshut"
            default 25
        config TOF3_XSHUT
            int "tof3 xshut"
            default 18
        config TOF4_XSHUT
            int "tof3 xshut"
            default 19
    endmenu

    menu "PWM Config"
        config M0_PWM
               int "Motor 0 PWM pin"
               default 23
        config M1_PWM
                int "Motor 1 PWM Pin"
                default 27
        config M2_PWM
                int "Motor 2 PWM Pin"
                default 22
        config M3_PWM
                int "Motor 3 PWM Pin"
                default 33
        config NECK_PITCH_PWM
                        int "Neck Pitch PWM"
                        default 16
        config NECK_YAW_PWM
                        int "Neck Pitch PWM"
                        default 17
    endmenu

    menu "API Commands and Params"
        config AUTO_DRIVE_COMMAND
            string "auto"
            default "auto"
        config DRIVE_COMMAND
            string "Drive command"
            default "drive"

        config MOVE_COMMAND
                string "MOVE command"
                default "move"

        config STOP_COMMAND
            string "Stop command"
            default "stop"

        config ROTATE_COMMAND
            string "Rotate command"
            default "rotate"

        config CALIBRATE_COMMAND
                string "Calibration command"
                default "calibrate"

        config CMD_PARAM_NAME
            string "Parameter used for command"
            default "cmd"

        config HEADING_PARAM_NAME
            string "Parameter used for heading setting"
            default "heading"

        config POWER_PARAM_NAME
            string "Parameter used for power setting"
            default "power"

        config TURN_PARAM_NAME
            string "Parameter used for turn setting"
            default "turn"
    endmenu
endmenu
```

## sdkconfig.defaults
```kconfig
#
# ESP Rover Config
#
# CONFIG_VL53L0X_DEBUG is not set
# CONFIG_ESP_ROVER_DEBUG is not set
CONFIG_ESP_ROVER_MAX_POWER=100

#
# Autodrive Thresholds
#
CONFIG_AUTODRIVE_FRONT_CENTER_THRESHOLD=420
CONFIG_AUTODRIVE_FRONT_LATERAL1_THRESHOLD=420
CONFIG_AUTODRIVE_FRONT_LATERAL2_THRESHOLD=420
CONFIG_AUTODRIVE_SIDE_CENTER_THRESHOLD=250
# end of Autodrive Thresholds

#
# TOF Sensor Config
#
CONFIG_TOF0_XSHUT=14
CONFIG_TOF1_XSHUT=26
CONFIG_TOF2_XSHUT=25
CONFIG_TOF3_XSHUT=18
CONFIG_TOF4_XSHUT=19
# end of TOF Sensor Config

#
# PWM Config
#
CONFIG_M0_PWM=23
CONFIG_M1_PWM=27
CONFIG_M2_PWM=32
CONFIG_M3_PWM=33
CONFIG_NECK_PITCH_PWM=16
CONFIG_NECK_YAW_PWM=17
# end of PWM Config

#
# API Commands and Params
#
CONFIG_AUTO_DRIVE_COMMAND="auto"
CONFIG_DRIVE_COMMAND="drive"
CONFIG_MOVE_COMMAND="move"
CONFIG_STOP_COMMAND="stop"
CONFIG_ROTATE_COMMAND="rotate"
CONFIG_CALIBRATE_COMMAND="calibrate"
CONFIG_CMD_PARAM_NAME="cmd"
CONFIG_HEADING_PARAM_NAME="heading"
CONFIG_POWER_PARAM_NAME="power"
CONFIG_TURN_PARAM_NAME="turn"
# end of API Commands and Params
# end of ESP Rover Config

#
# Example Connection Configuration
#
CONFIG_EXAMPLE_GPIO_RANGE_MIN=0
CONFIG_EXAMPLE_GPIO_RANGE_MAX=33
CONFIG_EXAMPLE_CONNECT_WIFI=y
CONFIG_EXAMPLE_WIFI_SSID="SIDUSA"
CONFIG_EXAMPLE_WIFI_PASSWORD="20052009"
# CONFIG_EXAMPLE_WIFI_SCAN_METHOD_FAST is not set
CONFIG_EXAMPLE_WIFI_SCAN_METHOD_ALL_CHANNEL=y
```
